## prj.conf
```kconfig
# Common coremark configuration
CONFIG_COREMARK=y

CONFIG_COREMARK_ITERATIONS=2000

# Single thread execution
CONFIG_COREMARK_THREADS_NUMBER=1
# Choose memory method
CONFIG_COREMARK_MEMORY_METHOD_STACK=y
#CONFIG_COREMARK_MEMORY_METHOD_MALLOC=y

# Supported only for single thread. No stack or heap required
#CONFIG_COREMARK_MEMORY_METHOD_STATIC=y

# Choose proper memory size based on memory method selected above
# For 1 thread
CONFIG_MAIN_STACK_SIZE=4096
#CONFIG_HEAP_MEM_POOL_SIZE=4096

# For 4 threads
CONFIG_TIMESLICE_SIZE=10
#CONFIG_MAIN_STACK_SIZE=10240
#CONFIG_HEAP_MEM_POOL_SIZE=10240

# Compiler options
CONFIG_COMPILER_OPT="-O3"

# Config results output
CONFIG_LOG=y
CONFIG_PRINTK=y
CONFIG_CBPRINTF_FP_SUPPORT=y
CONFIG_CONSOLE=y
CONFIG_PRINTK_SYNC=y

CONFIG_RTT_CONSOLE=y
CONFIG_USE_SEGGER_RTT=y

CONFIG_MAIN_THREAD_PRIORITY=-1
```

## src/main.c
```c
/*
 * Copyright (c) 2023 Nordic Semiconductor ASA
 *
 * SPDX-License-Identifier: Apache-2.0
 */

#include <zephyr/kernel.h>
#include <zephyr/logging/log.h>

#include "coremark_zephyr.h"

LOG_MODULE_REGISTER(app, LOG_LEVEL_INF);

int main(void)
{
	LOG_INF("Coremark sample for %s", CONFIG_BOARD);
	LOG_INF("(threads: %d, data size: %d; iterations: %d)\n",
		CONFIG_COREMARK_THREADS_NUMBER,
		CONFIG_COREMARK_DATA_SIZE,
		CONFIG_COREMARK_ITERATIONS);

	coremark_run();

	LOG_INF("Coremark finished! RESET to restart ...\n");

	return 0;
}
```
